## config/boards/shields/Kconfig.shield
```kconfig
config SHIELD_HALFRHYMESTONEWAYALESS
  def_bool $(shields_list_contains, halfrhymestonewayaless)
```

## config/boards/shields/halfrhymestone/Kconfig.defconfig
```kconfig
if SHIELD_HALFRHYMESTONE

  config ZMK_KEYBOARD_NAME
    default "Rhymestone"

  #CONFIG_BT_CTLR_TX_PWR_PLUS_8=y

  # Use the STRIP config specific to the LEDs you're using
  CONFIG_ZMK_RGB_UNDERGLOW=y
  CONFIG_WS2812_STRIP=y

  # Turn on logging, and set ZMK logging to debug output
  CONFIG_ZMK_USB_LOGGING=y

endif  
```

## config/boards/shields/halfrhymestone/Kconfig.shield
```kconfig
config SHIELD_HALFRHYMESTONE
  def_bool $(shields_list_contains, halfrhymestone)
```

## config/boards/shields/halfrhymestonewayaless/Kconfig.defconfig
```kconfig
if SHIELD_HALFRHYMESTONEWAYALESS

  config ZMK_KEYBOARD_NAME
    default "halfrhymestone"

  CONFIG_BT_CTLR_TX_PWR_PLUS_8=y

  CONFIG_ZMK_RGB_UNDERGLOW=y
  # Use the STRIP config specific to the LEDs you're using
  CONFIG_WS2812_STRIP=y

endif  
```
